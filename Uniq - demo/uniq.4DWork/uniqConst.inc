// File generated 31/05/2011 10:46:04
// Warning! This is a generated file, any manual changes will be
// lost during the next generation.

// object indexes for Inputs, Image Addresses + Input Array
#CONST
    iVideo1H          0x0000
    iVideo1L          0x0000
    iVideo2H          0x000B
    iVideo2L          0x5600
    iVideo3H          0x0012
    iVideo3L          0x8800
    iVideo4H          0x001E
    iVideo4L          0x4000
    iVideo5H          0x002A
    iVideo5L          0x3C00
    iVideo6H          0x0036
    iVideo6L          0x3800
    iVideo7H          0x0042
    iVideo7L          0x5400
    iVideo8H          0x004E
    iVideo8L          0xAE00
    iVideo9H          0x005A
    iVideo9L          0xCA00
    Inputs          0
#END


